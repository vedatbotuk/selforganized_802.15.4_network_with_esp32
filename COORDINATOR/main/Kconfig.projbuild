## COORDINATOR/main/Kconfig.projbuild
```kconfig
menu "Example Device Configuration"

    orsource "$IDF_PATH/examples/common_components/env_caps/$IDF_TARGET/Kconfig.env_caps"

    choice ZB_DEVICE_TYPE
    
        bool "Zigbee Coordinator or Router device"
        default ZB_ZCZR
        help 
            Select this to enable Zigbee Coordinator or Router.

    endchoice

endmenu
```

## FFD/main/Kconfig.projbuild
```kconfig
menu "Example Configuration"

  config ZB_RCP
        bool "Zigbee Radio Co-processor device"
        depends on <choice ZB_DEVICE_TYPE>
        help
          Select this to enable Zigbee Radio Only device which can only forward 802.15.4 packets to t
          The Zigbee stack will be run on the host SoC.

endmenu
```

## RFD/main/Kconfig.projbuild
```kconfig
menu "Example Device Configuration"

    orsource "$IDF_PATH/examples/common_components/env_caps/$IDF_TARGET/Kconfig.env_caps"

    choice ZB_DEVICE_TYPE
    
        bool "Zigbee End Device"
        default ZB_ZED
        help 
            Select this to enable Zigbee End Device.

    endchoice

endmenu
```

## manual_networking_root/main/Kconfig.projbuild
```kconfig
menu "Example Configuration"

    choice
        bool "Device type"
        default MESH_SET_ROOT
        help
            Device type (root or node).

        config MESH_SET_ROOT
            bool "MESH_SET_ROOT"
        config MESH_SET_NODE
            bool "MESH_SET_NODE"
    endchoice

    config MESH_CHANNEL
        int "channel"
        range 1 14
        default 1
        help
            mesh network channel.

    config MESH_ROUTER_SSID
        string "Router SSID"
        default "moto g31(w)_9569"
        help
            Router SSID.

    config MESH_ROUTER_PASSWD
        string "Router password"
        default "w4aqipb7h5eqt5e"
        help
            Router password.

    choice
        bool "Mesh AP Authentication Mode"
        default WIFI_AUTH_WPA2_PSK
        help
            Authentication mode.

        config WIFI_AUTH_OPEN
            bool "WIFI_AUTH_OPEN"
        config WIFI_AUTH_WPA_PSK
            bool "WIFI_AUTH_WPA_PSK"
        config WIFI_AUTH_WPA2_PSK
            bool "WIFI_AUTH_WPA2_PSK"
        config WIFI_AUTH_WPA_WPA2_PSK
            bool "WIFI_AUTH_WPA_WPA2_PSK"
    endchoice

    config MESH_AP_AUTHMODE
        int
        default 0 if WIFI_AUTH_OPEN
        default 2 if WIFI_AUTH_WPA_PSK
        default 3 if WIFI_AUTH_WPA2_PSK
        default 4 if WIFI_AUTH_WPA_WPA2_PSK
        help
            Mesh AP authentication mode.

    config MESH_AP_PASSWD
        string "Mesh AP Password"
        default "MAP_PASSWD"
        help
            Mesh AP password.

    config MESH_AP_CONNECTIONS
        int "Mesh AP Connections"
        range 1 10
        default 6
        help
            The number of mesh stations allowed to connect in.

    config MESH_NON_MESH_AP_CONNECTIONS
        int "Mesh Non Mesh AP Connections"
        range 0 9
        default 0
        help
            The number of non-mesh stations allowed to connect in.

    config MESH_MAX_LAYER
        int "Mesh Max Layer"
        range 1 25
        default 6
        help
            Max layer allowed in mesh network.

    config MESH_IE_CRYPTO_KEY
        string "Mesh IE Crypto Key"
        default "hello, esp-mesh."
        help
            Mesh IE ASCII crypto key, length in bytes, range:8~64.

    choice
        bool "Mesh IE Crypto Funcs"
        default IE_CRYPTO_ENABLE
        help
            Mesh IE crypto funcs.

        config IE_CRYPTO_ENABLE
            bool "IE_CRYPTO_ENABLE"
        config IE_CRYPTO_DISABLE
            bool "IE_CRYPTO_DISABLE"
    endchoice

    config MESH_IE_CRYPTO_FUNCS
        int
        default 1 if IE_CRYPTO_ENABLE
        default 0 if IE_CRYPTO_DISABLE
        help
             Mesh IE crypto enable/disable.

    choice BLINK_LED
        prompt "Blink LED type"
        default BLINK_LED_GPIO if IDF_TARGET_ESP32 || !SOC_RMT_SUPPORTED
        default BLINK_LED_RMT
        help
            Defines the default peripheral for blink example

        config BLINK_LED_GPIO
            bool "GPIO"
        config BLINK_LED_RMT
            bool "RMT - Addressable LED"
    endchoice
    
    orsource "$IDF_PATH/examples/common_components/env_caps/$IDF_TARGET/Kconfig.env_caps"

    config BLINK_GPIO
        int "Blink GPIO number"
        range ENV_GPIO_RANGE_MIN ENV_GPIO_OUT_RANGE_MAX
        default 5 if IDF_TARGET_ESP32
        default 18 if IDF_TARGET_ESP32S2
        default 48 if IDF_TARGET_ESP32S3
        default 8
        help
            GPIO number (IOxx) to blink on and off or the RMT signal for the addressable LED.
            Some GPIOs are used for other purposes (flash connections, etc.) and cannot be used to blink.

    config BLINK_PERIOD
        int "Blink period in ms"
        range 10 3600000
        default 1000
        help
            Define the blinking period in milliseconds.

endmenu
```
